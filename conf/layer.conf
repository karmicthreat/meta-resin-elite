## conf/layer.conf
```bitbake
BBPATH .= ":${LAYERDIR}"

BBFILES += "${LAYERDIR}/recipes-*/*/*.bb \
            ${LAYERDIR}/recipes-*/*/*.bbappend"

BBFILE_COLLECTIONS += "resin-elite"
BBFILE_PATTERN_resin-elite := "^${LAYERDIR}/"
BBFILE_PRIORITY_resin-elite = "1337"
```
